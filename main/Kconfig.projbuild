## main/Kconfig.projbuild
```kconfig
menu "PDP8 emulator configuration"

config WIFI_SSID
    string "WiFi SSID"
    default "myssid"
    help
	SSID (network name) for the example to connect to.

config WIFI_PASSWORD
    string "WiFi Password"
    default "mypassword"
    help
	WiFi password (WPA or WPA2) for the example to use.

config SC_CS
    string "GPIO portnumber for CS for SD-card"
    default 5
    help
  VSPI is used for SPI bus, MISO = 19, SCK = 18, MOSI = 23.

config TIMEZONE
    string "Time zone"
    default "CET-1:00:CEST-2:00:00,M3.5.0,M10.5.0"
    help
	See for http://www.remotemonitoringsystems.ca/time-zone-abbreviations.php for TZ format.
endmenu
```
